## build/conf/bblayers.conf
```bitbake
# POKY_BBLAYERS_CONF_VERSION is increased each time build/conf/bblayers.conf
# changes incompatibly
POKY_BBLAYERS_CONF_VERSION = "2"

BBPATH = "${TOPDIR}"
BBFILES ?= ""

BBLAYERS ?= " \
  /home/kevin/yocto-labs/poky/meta \
  /home/kevin/yocto-labs/poky/meta-poky \
  /home/kevin/yocto-labs/poky/meta-yocto-bsp \
  /home/kevin/yocto-labs/meta-arm/meta-arm \
  /home/kevin/yocto-labs/meta-arm/meta-arm-toolchain \
  /home/kevin/yocto-labs/meta-ti/meta-ti-bsp \
  /home/kevin/yocto-labs/meta-bootlinlabs \
  /home/kevin/yocto-labs/build/workspace \
  "
```
